/* ld Linker Script - (Debug/Release) */
/* Auto generated by DJYOS lds Editor */
/* Wed Nov 07 11:38:56 CST 2012 */

MEMORY
{
	ROM1(RX)		: org = 0x00000000, len = 2M
	RAM1(RXW)		: org = 0x08000000, len = 8M
}

SECTIONS
{
}
/**** The End ****/
