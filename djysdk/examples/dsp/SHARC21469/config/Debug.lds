/* ld Linker Script - (Debug/Release) */
/* Auto generated by DJYOS lds Editor */
/* Mon Oct 14 09:24:28 GMT+08:00 2013 */

MEMORY
{
	ROM1(RX)		: org = 0x00000000, len = 2M
	RAM1(RXW)		: org = 0x08000000, len = 8M
}

SECTIONS
{
	
	. = ALIGN(0x08);
	text_startup_rROM1_lROM1 :
	{
		KEEP(* (.isr_vector .isr_vector.*))
		./src/OS_code/bsp/arch/core/exceptions.o (.text .text.* .rodata .rodata.*)
		./src/OS_code/bsp/arch/startup/*.o (.text .text.* .rodata .rodata.*)
		./src/OS_code/loader/si/pre_loader.o (.text .text.* .rodata .rodata.*)
	}>ROM1 
}
/**** The End ****/
