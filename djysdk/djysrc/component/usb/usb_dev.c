//-----------------------------------------------------------------------------
// Copyright (c) 2014, SHENZHEN PENGRUI SOFT CO LTD. All rights reserved.

// Redistribution and use in source and binary forms, with or without
// modification, are permitted provided that the following conditions are met:

// 1. Redistributions of source code must retain the above copyright notice,
//    this list of conditions and the following disclaimer.
// 2. Redistributions in binary form must reproduce the above copyright notice,
//    this list of conditions and the following disclaimer in the documentation
//    and/or other materials provided with the distribution.
// 3. As a constituent part of djyos,do not transplant it to other software
//    without specific prior written permission.

// THIS SOFTWARE IS PROVIDED BY THE COPYRIGHT HOLDERS AND CONTRIBUTORS "AS IS"
// AND ANY EXPRESS OR IMPLIED WARRANTIES, INCLUDING, BUT NOT LIMITED TO, THE
// IMPLIED WARRANTIES OF MERCHANTABILITY AND FITNESS FOR A PARTICULAR PURPOSE
// ARE DISCLAIMED. IN NO EVENT SHALL THE COPYRIGHT HOLDER OR CONTRIBUTORS BE
// LIABLE FOR ANY DIRECT, INDIRECT, INCIDENTAL, SPECIAL, EXEMPLARY, OR
// CONSEQUENTIAL DAMAGES (INCLUDING, BUT NOT LIMITED TO, PROCUREMENT OF
// SUBSTITUTE GOODS OR SERVICES; LOSS OF USE, DATA, OR PROFITS; OR BUSINESS
// INTERRUPTION) HOWEVER CAUSED AND ON ANY THEORY OF LIABILITY, WHETHER IN
// CONTRACT, STRICT LIABILITY, OR TORT (INCLUDING NEGLIGENCE OR OTHERWISE)
// ARISING IN ANY WAY OUT OF THE USE OF THIS SOFTWARE, EVEN IF ADVISED OF THE
// POSSIBILITY OF SUCH DAMAGE.
//-----------------------------------------------------------------------------
// Copyright (c) 2014 著作权由深圳鹏瑞软件有限公司所有。著作权人保留一切权利。
//
// 这份授权条款，在使用者符合以下三条件的情形下，授予使用者使用及再散播本
// 软件包装原始码及二进位可执行形式的权利，无论此包装是否经改作皆然：
//
// 1. 对于本软件源代码的再散播，必须保留上述的版权宣告、本条件列表，以
//    及下述的免责声明。
// 2. 对于本套件二进位可执行形式的再散播，必须连带以文件以及／或者其他附
//    于散播包装中的媒介方式，重制上述之版权宣告、本条件列表，以及下述
//    的免责声明。
// 3. 本软件作为都江堰操作系统的组成部分，未获事前取得的书面许可，不允许移植到非
//    都江堰操作系统环境下运行。

// 免责声明：本软件是本软件版权持有人以及贡献者以现状（"as is"）提供，
// 本软件包装不负任何明示或默示之担保责任，包括但不限于就适售性以及特定目
// 的的适用性为默示性担保。版权持有人及本软件之贡献者，无论任何条件、
// 无论成因或任何责任主义、无论此责任为因合约关系、无过失责任主义或因非违
// 约之侵权（包括过失或其他原因等）而起，对于任何因使用本软件包装所产生的
// 任何直接性、间接性、偶发性、特殊性、惩罚性或任何结果的损害（包括但不限
// 于替代商品或劳务之购用、使用损失、资料损失、利益损失、业务中断等等），
// 不负任何责任，即在该种使用已获事前告知可能会造成此类损害的情形下亦然。
//-----------------------------------------------------------------------------
#include <stdlib.h>
#include <driver.h>
#include <djyfs/fat/port/drivers/fat_drivers.h>
#include <djyfs/fat/ff11/src/diskio.h>
#include "./stm32_usb_host_library/class/msc/inc/usbh_msc.h"

extern USBH_HandleTypeDef  hUSBHost;

int USB_Status(void);
int USB_Initialize(void);
int USB_Read(BYTE *Buff, DWORD Sector, UINT Count);
int USB_Write(BYTE *Buff, DWORD Sector, UINT Count);
int USB_Ioctl( BYTE Cmd, void *Buff);

struct FatDrvFuns USB_Drv =
{
	.DrvStatus     = USB_Status,
	.DrvInitialize = USB_Initialize,
	.DrvRead       = USB_Read,
	.DrvWrite      = USB_Write,
	.DrvIoctl      = USB_Ioctl
};

//-----------------------------------------------------------------------------
//功能: USB状态
//参数:
//输出:
//返回:
//-----------------------------------------------------------------------------
s32 __USB_Status(void)
{
    s32 Res = 1; //RES_ERROR;
  
	if(USBH_MSC_UnitIsReady (&hUSBHost, 0))
	{
		Res = 0; //RES_OK;
	}
	else
	{
		Res = 1; //RES_ERROR;
	}
  
	return Res;
}

//-----------------------------------------------------------------------------
//功能: USB初始化
//参数:
//返回:
//备注: 可以将设备初始化放在这里;
//-----------------------------------------------------------------------------
s32 __USB_Initialize(void)
{
	static BYTE Done = 0;

    if(1 == Done)
        return (0);

    Done = 1;
    return (0);
}

//-----------------------------------------------------------------------------
//功能: USB读数据
//参数:
//返回:
//备注:
//-----------------------------------------------------------------------------
s32 __USB_Read(u8 *buff, u32 sector, u32 count)
{
	u8 pdrv = 0;
	s32 res = 1; // RES_ERROR;
	MSC_LUNTypeDef info;
	USBH_StatusTypeDef  status = USBH_OK;
	u32 scratch [_MAX_SS / 4];

	if ((u32)buff & 3) // DMA Alignment issue, do single up to aligned buffer
	{
		while ((count--)&&(status == USBH_OK))
		{
			status = USBH_MSC_Read(&hUSBHost, pdrv, sector + count, (uint8_t *)scratch, 1);
			if(status == USBH_OK)
			{
				memcpy(&buff[count * _MAX_SS], scratch, _MAX_SS);
			}
			else
			{
				break;
			}
		}
	}
	else
	{
		status = USBH_MSC_Read(&hUSBHost, pdrv, sector, buff, count);
	}

	if(status == USBH_OK)
	{
		res = 0; // RES_OK;
	}
	else
	{
		USBH_MSC_GetLUNInfo(&hUSBHost, pdrv, &info); 

		switch (info.sense.asc)
		{
			case SCSI_ASC_LOGICAL_UNIT_NOT_READY:
			case SCSI_ASC_MEDIUM_NOT_PRESENT:
			case SCSI_ASC_NOT_READY_TO_READY_CHANGE: 
				printf("\r\nUSB Disk is not ready!\r\n");  
				res = 3; // RES_NOTRDY;
				break; 
			
			default:
				res = 1; // RES_ERROR;
				break;
		}
	}

	return res;
}

//-----------------------------------------------------------------------------
//功能: 写数据
//参数: buff -- 写入内容。
//     sector -- 目标页号。
//     count -- 页数量。
//返回: 0 -- 正确;-1 -- 错误;
//备注:
//-----------------------------------------------------------------------------
s32 __USB_Write(u8 *buff, u32 sector, u32 count)
{
	u8 pdrv = 0;
	s32 res = 0; // RES_ERROR;
	MSC_LUNTypeDef info;
	USBH_StatusTypeDef  status = USBH_OK;  
	u32 scratch [_MAX_SS / 4];  
	
	if ((u32)buff & 3) /* DMA Alignment issue, do single up to aligned buffer */
	{
		while (count--)
		{
			memcpy (scratch, &buff[count * _MAX_SS], _MAX_SS);
	
			status = USBH_MSC_Write(&hUSBHost, pdrv, sector + count, (BYTE *)scratch, 1);
			if(status == USBH_FAIL)
			{
				break;
			}
		}
	}
	else
	{
		status = USBH_MSC_Write(&hUSBHost, pdrv, sector, (BYTE *)buff, count);
	}
	
	if(status == USBH_OK)
	{
		res = 0; // RES_OK;
	}
	else
	{
		USBH_MSC_GetLUNInfo(&hUSBHost, pdrv, &info); 
	
		switch (info.sense.asc)
		{
			case SCSI_ASC_WRITE_PROTECTED:
				printf("USB Disk is Write protected!");
				res = 2; // RES_WRPRT;
				break;
	
			case SCSI_ASC_LOGICAL_UNIT_NOT_READY:
			case SCSI_ASC_MEDIUM_NOT_PRESENT:
			case SCSI_ASC_NOT_READY_TO_READY_CHANGE:
				printf("USB Disk is not ready!");      
				res = 3; // RES_NOTRDY;
				break; 
	
			default:
				res = 1; // RES_ERROR;
				break;
		}
	}
	
	return res;   
}

//-----------------------------------------------------------------------------
//功能:
//参数:
//返回:
//备注:
//-----------------------------------------------------------------------------
s32 __USB_Ioctl( u8 cmd, void *buff)
{
	u8 pdrv = 0;
	DRESULT res = 0; // RES_OK;
	MSC_LUNTypeDef info;

	switch (cmd) {
		/* Make sure that no pending write process */  
		case CTRL_SYNC:
			res = 0; // RES_OK;
			break;
	
		/* Get number of sectors on the disk (DWORD) */ 
		case GET_SECTOR_COUNT:
			if(USBH_MSC_GetLUNInfo(&hUSBHost, pdrv, &info) == USBH_OK)
			{
				*(u32*)buff = info.capacity.block_nbr;
				res =  0; // RES_OK;
			}
			else
			{
				res =  1; // RES_ERROR;
			}
			break;
	
		case GET_SECTOR_SIZE: /* Get R/W sector size (WORD) */
			if(USBH_MSC_GetLUNInfo(&hUSBHost, pdrv, &info) == USBH_OK)
			{
				*(u32*)buff = info.capacity.block_size;
				res = 0; // RES_OK;
			}
			else
			{
				res = 1; // RES_ERROR;
			}
			break;
	
		/* Get erase block size in unit of sector (DWORD) */  
		case GET_BLOCK_SIZE:
			if(USBH_MSC_GetLUNInfo(&hUSBHost, pdrv, &info) == USBH_OK)
			{
				*(u32*)buff = info.capacity.block_size;
				res = 0; // RES_OK;
			}
			else
			{
				res = 1; // RES_ERROR;
			}
			break;
	
		default:
			res = 4; // RES_PARERR;
	}

	return res;
}

//-----------------------------------------------------------------------------
//功能:
//参数:
//返回:
//备注:
//-----------------------------------------------------------------------------
int USB_Ioctl( u8 Cmd, void *Buff)
{
	return(__USB_Ioctl((BYTE)Cmd, Buff));
}

//-----------------------------------------------------------------------------
//功能:
//参数:
//返回:
//备注:
//-----------------------------------------------------------------------------
int USB_Status(void)
{
	return (__USB_Status());
}

//-----------------------------------------------------------------------------
//功能:
//参数:
//返回:
//备注:
//-----------------------------------------------------------------------------
int USB_Initialize(void)
{
	return (__USB_Initialize());
}

//-----------------------------------------------------------------------------
//功能:
//参数:
//返回:
//备注:
//-----------------------------------------------------------------------------
int USB_Read(BYTE *Buff, DWORD Sector, UINT Count)
{
	return(__USB_Read((u8*)Buff, (u32)Sector, (u32)Count));
}

//-----------------------------------------------------------------------------
//功能:
//参数:
//返回:
//备注:
//-----------------------------------------------------------------------------
int USB_Write(BYTE *Buff, DWORD Sector, UINT Count)
{
	return(__USB_Write((u8*)Buff, (u32)Sector, (u32)Count));
}

//-----------------------------------------------------------------------------
//功能: 注册USB设备
//参数: ChipName -- 设备名; Clean -- 格式化器件。
//返回:
//备注:
//-----------------------------------------------------------------------------
s32 USB_Register(const char *ChipName, s32 Clean)
{
	char *Name;

	if(NULL == ChipName)
		return (-1);

	Name = (char*)malloc(strlen(ChipName)+1);
	if(NULL == Name)
		return (-2);

	strcpy(Name, ChipName);

	if(Driver_DeviceCreate(NULL, Name, NULL, NULL, NULL,
			NULL, NULL, NULL, ((ptu32_t)&USB_Drv)))
	{
		return (0);// 成功
	}

	free(Name);
	return (-3);// 操作失败
}
